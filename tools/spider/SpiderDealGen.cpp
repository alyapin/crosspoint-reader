// Prints lib/Games/SpiderDeals.h: build/test/games_core/SpiderDealGen > lib/Games/SpiderDeals.h
#include <chrono>
#include <cstdio>
#include <cstdlib>
#include <vector>

#include "SpiderSolver.h"

namespace {

constexpr int PER_MODE = 256;
constexpr uint32_t NODE_LIMIT = 300000;

// The line must also win through Game, the code the device runs.
bool wins(const uint32_t seed, const int suits, const std::vector<spider::Step>& line) {
  spider::Game game;
  game.newGame(seed, suits, false);
  for (const spider::Step& s : line) {
    if (!(s.from == spider::STOCK ? game.deal() : game.move(s.from, s.to, s.count))) return false;
  }
  return game.isWon();
}

void emit(const int suits, const int wanted) {
  std::vector<spider::Step> line;
  std::vector<uint32_t> seeds;
  int tried = 0;
  const auto t0 = std::chrono::steady_clock::now();
  for (uint32_t seed = suits * 1000000u + 1; static_cast<int>(seeds.size()) < wanted; ++seed) {
    uint8_t deck[spider::DECK];
    spider::shuffledDeck(seed, suits, deck);
    spider::Board board;
    spider::deal(board, deck);
    ++tried;
    if (spider::solve(board, NODE_LIMIT, line) && wins(seed, suits, line)) seeds.push_back(seed);
  }
  const double s = std::chrono::duration<double>(std::chrono::steady_clock::now() - t0).count();
  fprintf(stderr, "%d suits: %d of %d deals solved within %u nodes, %.1f s\n", suits, wanted, tried, NODE_LIMIT, s);
  printf("constexpr int SOLVABLE_%dSUIT_COUNT = %d;\n", suits, wanted);
  printf("constexpr uint32_t SOLVABLE_%dSUIT[SOLVABLE_%dSUIT_COUNT] = {", suits, suits);
  for (size_t i = 0; i < seeds.size(); ++i) printf("%s%u,", i % 10 == 0 ? "\n    " : " ", seeds[i]);
  printf("\n};\n\n");
}

}  // namespace

int main(const int argc, char** argv) {
  const int wanted = argc > 1 ? atoi(argv[1]) : PER_MODE;
  printf(
      "#pragma once\n\n"
      "// Generated by tools/spider/SpiderDealGen.cpp: shuffledDeck() seeds whose deals the\n"
      "// host solver won (all cards known). Host-tested by replaying solver lines through Game.\n\n"
      "#include <cstdint>\n\n"
      "namespace spider {\n\n");
  emit(1, wanted);
  emit(2, wanted);
  printf("}  // namespace spider\n");
  return 0;
}
